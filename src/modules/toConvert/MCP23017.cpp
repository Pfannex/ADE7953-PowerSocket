#include "MCP23017.h"
#include <Arduino.h>

//===============================================================================
//  GPIO
//===============================================================================
MCP23017::MCP23017(LOGGING &logging, TopicQueue &topicQueue)
    : logging(logging), topicQueue(topicQueue) {}


//-------------------------------------------------------------------------------
//  GPIO public
//-------------------------------------------------------------------------------
//...............................................................................
// start
//...............................................................................
void MCP23017::start() {

  logging.info("starting MCP23017");

  pinMode(12, INPUT_PULLUP);
  attachInterrupt(digitalPinToInterrupt(12), std::bind(&MCP23017::irq, this), RISING);
}

//...............................................................................
// handle
//...............................................................................
void MCP23017::handle() {

  while (irqDetected > 0){
    detachInterrupt(12);
    irqDetected--;
    logging.debug("IRQ");
    attachInterrupt(digitalPinToInterrupt(12), std::bind(&MCP23017::irq, this), RISING);
  }

}

//...............................................................................
// IRQ
//...............................................................................
void MCP23017::irq() {
  irqDetected++;
}


//...............................................................................
//  GPIO set
//...............................................................................
String MCP23017::set(Topic &topic) {
  /*
  ~/set
    └─gpio
        └─led (on, off, blink)
  */

  logging.debug("MCP23017 set topic " + topic.topic_asString() + " to " +
                topic.arg_asString());

  if (topic.itemIs(3, "led")) {
    return TOPIC_OK;
  } else {
    return TOPIC_NO;
  }
}
//...............................................................................
//  GPIO get
//...............................................................................
String MCP23017::get(Topic &topic) {
  /*
  ~/get
    └─gpio
        └─led (on, off, blink)
  */

  logging.debug("MCP23017 get topic " + topic.topic_asString() + " to " +
                topic.arg_asString());

  if (topic.itemIs(3, "led")) {
    return TOPIC_OK;
  } else {
    return TOPIC_NO;
  }
}
//...............................................................................
//  GPIO get
//...............................................................................
void MCP23017::on_events(Topic &topic){
  //Serial.println(topic.asString());
}
//-------------------------------------------------------------------------------
//  GPIO private
//-------------------------------------------------------------------------------
